## config/boards/shields/mininovaii/Kconfig.shield
```kconfig
# Copyright (c) 2021 The ZMK Contributors
# SPDX-License-Identifier: MIT

config SHIELD_MY_BOARD
	def_bool $(shields_list_contains,mininovaii)
```
